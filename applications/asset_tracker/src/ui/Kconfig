## applications/asset_tracker/src/ui/Kconfig
```kconfig
#
# Copyright (c) 2019 Nordic Semiconductor ASA
#
# SPDX-License-Identifier: LicenseRef-BSD-5-Clause-Nordic
#

menu "User Interface"

config UI_LED_USE_PWM
	bool "Use PWM to control LEDs"
	default y if BOARD_NRF9160_PCA20035NS

endmenu
```

## drivers/lte_link_info/Kconfig
```kconfig
#
# Copyright (c) 2019 Nordic Semiconductor
#
# SPDX-License-Identifier: LicenseRef-BSD-5-Clause-Nordic
#

menuconfig LTE_LINK_INFO
    bool "nRF91 LTE Link info library"
    select BSD_LIBRARY
    select AT_CMD_PARSER
    select AT_CMD_PARAMS

if LTE_LINK_INFO

config LTE_LI_MAX_AT_PARAMS_RSP
    int "Maximum number of response parameters"
    default 8
    help
        Set the maximum number of parameters the parser
        will check for in any given string.

config LTE_LI_BUFFER_SIZE
    int "Size of buffer used to read data from the socket"
    default 128
    help
        Set the buffer size which contains the returned
        string after an AT-command. The buffer is processed
        through the parser.

endif # LTE_LINK_INFO
```

## lib/at_params/Kconfig
```kconfig
#
# Copyright (c) 2019 Nordic Semiconductor ASA
#
# SPDX-License-Identifier: LicenseRef-BSD-5-Clause-Nordic
#

menuconfig AT_CMD_PARAMS
    bool "AT command parameters library"

if AT_CMD_PARAMS

endif # AT_CMD_PARAMS
```

## lib/modem_info/Kconfig
```kconfig
#
# Copyright (c) 2019 Nordic Semiconductor
#
# SPDX-License-Identifier: LicenseRef-BSD-5-Clause-Nordic
#

menuconfig MODEM_INFO
	bool "nRF91 Modem info library"
	select BSD_LIBRARY
	select AT_CMD_PARSER
	select AT_CMD_PARAMS

if MODEM_INFO

config MODEM_INFO_MAX_AT_PARAMS_RSP
	int "Maximum number of response parameters"
	default 8
	help
		Set the maximum number of parameters the parser
		will check for in any given string.

config MODEM_INFO_BUFFER_SIZE
	int "Size of buffer used to read data from the socket"
	default 128
	help
		Set the buffer size which contains the returned
		string after an AT-command. The buffer is processed
		through the parser.

config MODEM_INFO_SOCKET_BUF_SIZE
	int "LI socket Rx buffer size"
	default 328

config MODEM_INFO_THREAD_PRIO
	# Hidden option for preemptive LTE LI thread priority
	int
	range 0 NUM_PREEMPT_PRIORITIES
	default 0 if !MULTITHREADING
	default 10

endif # MODEM_INFO
```

## subsys/net/lib/cloud/Kconfig
```kconfig
# Copyright (c) 2018 Nordic Semiconductor
#
# SPDX-License-Identifier: LicenseRef-BSD-5-Clause-Nordic
#

menuconfig CLOUD_API
	bool "Cloud API"

if CLOUD_API


endif # CLOUD
```
